#! armcc -E

#define STACK_SIZE 0x2000
#define ROM_BASE	0x60000000
#define IVT_BASE	0x60001000
#define ITCM_SIZE	32*1024
#define DTCM_SIZE	(512-32)*1024
#define OCRAM_SIZE	0

#define OMV_MAIN_FB_SIZE	160*1024 //301*1024
#define OMV_FB_ALLOC_SIZE	13*1024 //83*1024
#define OMV_JPEG_FB_SIZE    23*1024

; must use "VECTOR_RAM", "RW_m_data", "VECTOR_ROM" as names to work with "InstallIRQHandler()" API

LR_XIP_FLASH_INFO ROM_BASE  {
  ; >>> RO regions
	ER_boot_hdr_conf +0 0xF000 {
	* (.boot_hdr.conf)
	}
}

LR_XIP_FLASH_IVT IVT_BASE {
	ER_boot_hdr_ivt +0 0x20 {
	* (.boot_hdr.ivt)
	}
	ER_boot_hdr_boot_data +0 0x10{
	* (.boot_hdr.boot_data)
	}  
	ER_boot_hdr_dcd_data +0 {
	* (.boot_hdr.dcd_data)
	}
}

LR_XIP_FLASH ROM_BASE + 0x2000 {
	VECTOR_ROM +0 0x400 { ; vector table
		* (RESET,+FIRST)
		* (InRoot$$Section)
	}
	
	TEXT_ROM +0  { ; load address = execution address
		.ANY (+RO)
	}

	VECTOR_RAM 0 EMPTY 1*1024 { ; RAM vector region (in RAMX)
	}
	ER_ITCM +0 ITCM_SIZE - 8*1024 - 1*1024 { ; Stack region growing down
		// vm.o pendsv.o objfun.o (+RO)
		// nlrthumb.o (+RO)
		// framebuffer.o fb_alloc.o (+RO)
		gc.o rt_mem*.o (+RO)
		collections.o array.o xalloc.o (+RO)
		arm_nn_mat*.o (+RO)
		// obj.o objarray.o objfloat.o objlist.o objobject.o  (+RO)
		// objfun.o  nativeglue.o malloc.o (+RO)	
		// objdict.o  modmath.o modarray.o modbuiltins.o modmicropython.o map.o (+RO)
		/*
		acos*.o asin*.o atan*.o ceil*.o cos*.o erf*.o expf*.o expm*.o floor*.o fmod*.o (+RO)
		frexp*.o ldex*.o lgamma*.o log*.o modff.o nanf.o nearbyintf.o powf.o roundf.o (+RO)
		sin*.o sqrt*.o tan*.o tgammaf*.o trunc*.o dunder.o funder.o (+RO)
		*/
		* (.ram_code)
	}
	ARM_LIB_STACK 0x6000 - STACK_SIZE EMPTY STACK_SIZE {}
	
	OVERLAY_CODE_Start 0x6000 EMPTY 0 {}
	
	OVERLAY_CODE_BLOB +0 OVERLAY 8*1024 {
		blob.o (+RO)
	}
	
	OVERLAY_CODE_JPEG +0 OVERLAY 8*1024 {
		jpeg.o (+RO)
	}
	
    DTCM_START_PLACEHOLDER 0x20000000 EMPTY 0 {}
	
	QH_BUFFER_LAYOUT +0 {
		* (.qh_buffer_2kalign)
	}
	
	OVERLAY_HAAR +0 OVERLAY {
		haar.o integral_mw.o (+RO)
	}
	
	
	OVERLAY_LAB_TAB +0  OVERLAY {
		lab_tab.o (+RO)
		xyz_tab.o (+RO)
	}	
	
	OVERLAY_YUV_TAB +0 OVERLAY 196*1024 {
		yuv_tab.o  (+RO)
		* (.jpeg_tab)
	}	
	
	
	OVERLAY_FLASHPGM +0 OVERLAY 8*1024 {
		fsl_flexspi.o flash_hyper.o (+RO)
	}	
	
	ER_DTCM +0 {
		.ANY (+RW, +ZI)
		* (.jpeg_buf)
		sincos_tab.o (+RO)
		virtual_com.o (+RW +ZI)
		* (.ram_const)
	}
	
	ARM_LIB_HEAP +0 EMPTY 0x100 ; Heap region growing up
	{}
	
	OMV_MAIN_FB +0 EMPTY OMV_MAIN_FB_SIZE  + OMV_FB_ALLOC_SIZE {}
//	OMV_FB_ALLOC +0 EMPTY OMV_FB_ALLOC_SIZE {}
	OMV_FB_END +0 EMPTY 16 {}	

	MPY_HEAP_START +0 EMPTY 4 {
	}	

	; <<<

	; >>> SDRAM >>>
	ER_LCD_FB 0x81C00000 UNINIT 1024*1024  {
		* (.lcd_fb)
	}
		

	;RW_SDRAM 0xA0100000 EMPTY UNINIT (32-1)*1024*1024  {
	;}
	; <<<
}

LR_TABs IVT_BASE+0x160000
{
	ER_TABS +0 {
		rgb2rgb*.o (+RO)
	}
}

#! armcc -E

#define STACK_SIZE 0x1800
#define IVT_BASE	0x80000000
#define ITCM_SIZE	320*1024
#define DTCM_SIZE	(512-320)*1024
#define OCRAM_SIZE	0

#define OMV_MAIN_FB_SIZE	160*1024 //301*1024
#define OMV_JPEG_FB_SIZE    24*1024
#define OMV_FB_ALLOC_SIZE	13*1024 //83*1024

; must use "VECTOR_RAM", "RW_m_data", "VECTOR_ROM" as names to work with "InstallIRQHandler()" API

LR_XIP_FLASH_INFO IVT_BASE  {
  ; >>> RO regions
	ER_boot_hdr_conf +0 0x1000 {
	* (.boot_hdr.conf)
	}
	ER_boot_hdr_ivt IVT_BASE + 0x1000 0x20 {
	* (.boot_hdr.ivt)
	}
	ER_boot_hdr_boot_data +0 0x10{
	* (.boot_hdr.boot_data)
	}  
	ER_boot_hdr_dcd_data +0 {
	* (.boot_hdr.dcd_data)
	}
}

LR_XIP_FLASH IVT_BASE + 0x2000 {
	VECTOR_ROM +0  { ; vector table
		* (RESET,+FIRST)
		* (InRoot$$Section)
		__*.o anon*.o (+RO)
		startup*.o system_*.o (+RO)
		.ANY (+RO)
	}
	
	OMV_MAIN_FB 0 EMPTY OMV_MAIN_FB_SIZE {}
	ER_ITCM +0 ITCM_SIZE { ; Stack region growing down
		jpeg.o yuv_tab.o (+RO)
		* (.ram_code)
	}
		

	ARM_LIB_STACK 0x20000000 EMPTY STACK_SIZE {}
	
	ER_DTCM 0x20000000 + STACK_SIZE DTCM_SIZE-STACK_SIZE {
		.ANY (+RW, +ZI)
	}
	VECTOR_RAM +0 EMPTY 4 { ; RAM vector region (in RAMX)
	}


	ARM_LIB_HEAP +0 EMPTY 0x10 ; Heap region growing up
	{}
	
	OMV_JPEG_FB +0 EMPTY OMV_JPEG_FB_SIZE {}
	
	MPY_HEAP_START +0 EMPTY 4 {
	}	

	RW_m_data 0x20200000 OCRAM_SIZE { ; RW data
	}

	; <<<

	; >>> SDRAM >>>
	ER_LCD_FB 0x81E00000 UNINIT 1024*1024  {
		* (.lcd_fb)
		// yuv_tab.o (+RO)
	}
	

	OMV_FB_ALLOC +0 EMPTY OMV_FB_ALLOC_SIZE {}
	
	;RW_SDRAM 0xA0100000 EMPTY UNINIT (32-1)*1024*1024  {
	;}
	; <<<
}
